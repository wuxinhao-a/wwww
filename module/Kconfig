## module/Kconfig
```kconfig
menu "HELLO TEST Driver "
comment "HELLO TEST Driver Config"
 
config HELLO
	tristate "hello module test"
	default m
	help
	This is the hello test driver --by wxh.
 
endmenu
```
